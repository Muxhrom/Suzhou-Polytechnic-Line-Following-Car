#include "oled.h"

unsigned char code F6x8[][6] = {
    {0x00,0x00,0x00,0x00,0x00,0x00},
    {0x00,0x00,0x00,0x2f,0x00,0x00},
    {0x00,0x00,0x07,0x00,0x07,0x00},
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    {0x00,0x00,0x01,0x02,0x04,0x00}
};

static void Delay_I2C(void)
{
    unsigned char i=5;
    while(i--);
}

static void I2C_Start(void)
{
    OLED_SDA = 1; OLED_SCL = 1;
    Delay_I2C();
    OLED_SDA = 0;
    Delay_I2C();
    OLED_SCL = 0;
}

static void I2C_Stop(void)
{
    OLED_SDA = 0; OLED_SCL = 1;
    Delay_I2C();
    OLED_SDA = 1;
    Delay_I2C();
}

static void WriteByte(unsigned char dat)
{
    unsigned char i;
    for(i=0;i<8;i++)
    {
        if(dat & 0x80) OLED_SDA=1; else OLED_SDA=0;
        Delay_I2C();
        OLED_SCL=1; 
        Delay_I2C();
        OLED_SCL=0; 
        Delay_I2C();
        dat <<= 1;
    }
    OLED_SCL = 1;
    Delay_I2C();
    OLED_SCL = 0;
    Delay_I2C();
}

static void WriteCmd(unsigned char cmd)
{
    I2C_Start();
    WriteByte(0x78); // 0x7A 改为 0x78
    WriteByte(0x00);
    WriteByte(cmd);
    I2C_Stop();
}
static void WriteData(unsigned char dat)
{
    I2C_Start();
    WriteByte(0x78); // 0x7A 改为 0x78
    WriteByte(0x40);
    WriteByte(dat);
    I2C_Stop();
}

void OLED_Init(void)
{
    unsigned int i=2000;while(i--); // 上电等待
    
    WriteCmd(0xAE);    // 关闭显示
    WriteCmd(0xD5); WriteCmd(0x80);
    WriteCmd(0xA8); WriteCmd(0x3F);
    WriteCmd(0xD3); WriteCmd(0x00);
    WriteCmd(0x40);
    WriteCmd(0x8D); WriteCmd(0x14); // 电荷泵
    WriteCmd(0x20); WriteCmd(0x02); // 新增：页寻址模式
    WriteCmd(0xA1); WriteCmd(0xC8);
    WriteCmd(0xDA); WriteCmd(0x12);
    WriteCmd(0x81); WriteCmd(0xCF);
    WriteCmd(0xD9); WriteCmd(0xF1);
    WriteCmd(0xDB); WriteCmd(0x40);
    WriteCmd(0xA4); WriteCmd(0xA6);
    WriteCmd(0xAF);    // 开启显示
    
    OLED_Clear();
}

void OLED_Clear(void)
{
    unsigned char i,j;
    for(i=0;i<8;i++)
    {
        WriteCmd(0xB0+i);
        WriteCmd(0x00);
        WriteCmd(0x10);
        for(j=0;j<128;j++)
            WriteData(0x00);
    }
}

void OLED_ShowChar(unsigned char x, unsigned char y, unsigned char chr)
{
    unsigned char c,i;
    c = chr - 32;
    if(c > 63) c = 0;
    
    WriteCmd(0xB0 + y);
    WriteCmd(((x & 0xF0) >> 4) | 0x10);
    WriteCmd((x & 0x0F) | 0x01);
    
    for(i=0;i<6;i++)
        WriteData(F6x8[c][i]);
}

void OLED_ShowString(unsigned char x, unsigned char y, unsigned char *str)
{
    while(*str)
    {
        OLED_ShowChar(x, y, *str++);
        x += 6;    // 字符宽6像素，横向右移
        if(x > 122) // 一行到头换行
        {
            x = 0;
            y += 1; // +8 改为 +1
        }
    }
}

void OLED_ShowNum(unsigned char x, unsigned char y, unsigned int num, unsigned char len)
{
    unsigned char t,temp;
    unsigned char show[6];
    unsigned char i=0;
    
    for(t=0;t<len;t++)
    {
        unsigned long p=1,n;
        for(n=0;n<len-t-1;n++) p*=10;
        temp = (num / p) % 10;
        show[i++] = temp + '0';
    }
    show[i] = '\0';
    OLED_ShowString(x, y, show);
}